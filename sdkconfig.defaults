## sdkconfig.defaults
```kconfig
#
# ESP32-C6 OpenThread Border Router — sdkconfig defaults
#
# These settings configure ESP-IDF v5.5 for a standalone Thread Border Router
# using the ESP32-C6's native Wi-Fi + 802.15.4 radios.
#

# ---- System ----
CONFIG_ESPTOOLPY_FLASHSIZE_4MB=y
CONFIG_ESP_SYSTEM_EVENT_TASK_STACK_SIZE=4096
CONFIG_ESP_MAIN_TASK_STACK_SIZE=8192
CONFIG_ESP_TASK_WDT_TIMEOUT_S=30
CONFIG_ESP_TASK_WDT_CHECK_IDLE_TASK_CPU0=n

# ---- Partition table ----
CONFIG_PARTITION_TABLE_CUSTOM=y
CONFIG_PARTITION_TABLE_CUSTOM_FILENAME="partitions.csv"
CONFIG_PARTITION_TABLE_FILENAME="partitions.csv"

# ---- Wi-Fi ----
CONFIG_ESP_WIFI_ENABLED=y
CONFIG_ESP_WIFI_STA_DISCONNECTED_PM_ENABLE=n
CONFIG_ESP_WIFI_SOFTAP_SUPPORT=n

# ---- Wi-Fi / 802.15.4 Coexistence ----
# CRITICAL: The ESP32-C6 shares one 2.4 GHz radio between Wi-Fi and
# 802.15.4 (Thread).  This enables time-division multiplexing so both
# protocols can operate on the same chip.
CONFIG_ESP_COEX_SW_COEXIST_ENABLE=y

# ---- LWIP ----
CONFIG_LWIP_IPV6=y
CONFIG_LWIP_IPV6_FORWARD=y
CONFIG_LWIP_MULTICAST_PING=y
CONFIG_LWIP_NETIF_STATUS_CALLBACK=y
CONFIG_LWIP_HOOK_IP6_ROUTE_DEFAULT=y
CONFIG_LWIP_HOOK_ND6_GET_GW_DEFAULT=y
CONFIG_LWIP_HOOK_IP6_INPUT_CUSTOM=y
CONFIG_LWIP_HOOK_IP6_SELECT_SRC_ADDR_CUSTOM=y
CONFIG_LWIP_IPV6_NUM_ADDRESSES=12
CONFIG_LWIP_IPV6_AUTOCONFIG=y
CONFIG_LWIP_IPV4=y

# ---- mDNS (managed component — enabled by including espressif/mdns) ----
CONFIG_MDNS_MULTIPLE_INSTANCE=y

# ---- OpenThread core ----
CONFIG_OPENTHREAD_ENABLED=y
CONFIG_OPENTHREAD_FTD=y
CONFIG_OPENTHREAD_RADIO_NATIVE=y

# Thread network settings
CONFIG_OPENTHREAD_NETWORK_NAME="OpenThread-HA"
CONFIG_OPENTHREAD_NETWORK_CHANNEL=15
CONFIG_OPENTHREAD_NETWORK_PANID=0x1234

# ---- OpenThread Border Router ----
# This single flag auto-enables: border routing, SRP server, DNS-SD server,
# NAT64, DHCP6 client/server (via openthread-core-esp32x-ftd-config.h)
CONFIG_OPENTHREAD_BORDER_ROUTER=y
CONFIG_OPENTHREAD_DNS64_CLIENT=y
CONFIG_OPENTHREAD_SRP_CLIENT=y
CONFIG_OPENTHREAD_SRP_CLIENT_MAX_SERVICES=5

# ---- OpenThread CLI (for serial provisioning) ----
CONFIG_OPENTHREAD_CLI=y

# ---- OpenThread logging ----
CONFIG_OPENTHREAD_LOG_LEVEL_DYNAMIC=y
CONFIG_OPENTHREAD_LOG_LEVEL_NOTE=y

# ---- OpenThread commissioner / joiner ----
CONFIG_OPENTHREAD_COMMISSIONER=y
CONFIG_OPENTHREAD_JOINER=y

# ---- mbedTLS (required for Thread DTLS commissioning) ----
CONFIG_MBEDTLS_CMAC_C=y
CONFIG_MBEDTLS_SSL_PROTO_DTLS=y
CONFIG_MBEDTLS_KEY_EXCHANGE_ECJPAKE=y
CONFIG_MBEDTLS_ECJPAKE_C=y

# ---- Event-fd support (required by OT platform layer) ----
CONFIG_VFS_SUPPORT_IO=y
CONFIG_VFS_SUPPORT_SELECT=y

# ---- UART (for CLI over USB-CDC) ----
CONFIG_ESP_CONSOLE_USB_SERIAL_JTAG=y

# ---- Memory optimization ----
CONFIG_FREERTOS_UNICORE=y
CONFIG_ESP_DEFAULT_CPU_FREQ_MHZ_160=y
CONFIG_COMPILER_OPTIMIZATION_SIZE=y
```
